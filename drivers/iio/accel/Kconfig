## drivers/iio/accel/Kconfig
```kconfig
#
# Accelerometer drivers
#
menu "Accelerometers"

config HID_SENSOR_ACCEL_3D
	depends on HID_SENSOR_HUB
	select IIO_BUFFER
	select IIO_TRIGGERED_BUFFER
	select HID_SENSOR_IIO_COMMON
	select HID_SENSOR_IIO_TRIGGER
	tristate "HID Accelerometers 3D"
	help
	  Say yes here to build support for the HID SENSOR
	  accelerometers 3D.
 
config IIO_LIS331DLH_INTEL_QRK
        tristate "STMicroelectronics LIS331DLH accelerometer i2c driver for Intel Quark platform"
        depends on INTEL_QUARK_X1000_SOC
	depends on I2C && SYSFS
	select IIO_ST_SENSORS_CORE
        help
          Selects the LIS331DLH accelerometer driver for the Intel Clanton Hill platform

endmenu
```

## drivers/net/ethernet/stmicro/stmmac/Kconfig
```kconfig
config STMMAC_ETH
	tristate "STMicroelectronics 10/100/1000 Ethernet driver"
	depends on HAS_IOMEM
	select NET_CORE
	select MII
	select PHYLIB
	select CRC32
	---help---
	  This is the driver for the Ethernet IPs are built around a
	  Synopsys IP Core and only tested on the STMicroelectronics
	  platforms.

if STMMAC_ETH

config STMMAC_PLATFORM
	bool "STMMAC Platform bus support"
	depends on STMMAC_ETH
	default y
	---help---
	  This selects the platform specific bus support for
	  the stmmac device driver. This is the driver used
	  on many embedded STM platforms based on ARM and SuperH
	  processors.
	  If you have a controller with this interface, say Y or M here.

	  If unsure, say N.

config STMMAC_PCI
	bool "STMMAC PCI bus support"
	depends on STMMAC_ETH && PCI
	---help---
	  This is to select the Synopsys DWMAC available on PCI devices,
	  if you have a controller with this interface, say Y or M here.

	  This PCI support is tested on XLINX XC2V3000 FF1152AMT0221
	  D1215994A VIRTEX FPGA board.

	  If unsure, say N.

config STMMAC_DEBUG_FS
	bool "Enable monitoring via sysFS "
	default n
	depends on STMMAC_ETH && DEBUG_FS
	---help---
	  The stmmac entry in /sys reports DMA TX/RX rings
	  or (if supported) the HW cap register.

config STMMAC_DA
	bool "STMMAC DMA arbitration scheme"
	default n
	---help---
	  Selecting this option, rx has priority over Tx (only for Giga
	  Ethernet device).
	  By default, the DMA arbitration scheme is based on Round-robin
	  (rx:tx priority is 1:1).

config STMMAC_PTP
	bool "STMMAC PTP (1588-2005) Clock Support"
	default n
	depends on EXPERIMENTAL
	select PPS
	select PTP_1588_CLOCK
	---help---
	  Say Y here if you want support for 1588 Timestamping with a
	  Quark device, using the PTP 1588 Clock support. This is
	  required to enable timestamping support for the device.

	  If unsure, say N.

config STMMAC_PTP_CLK_MHZ
	depends on STMMAC_PTP
	int "Reference clock in Mhz"
	default 50
	---help---
	  Frequency in MHz of the reference clock used to derive PTP time
	  locally. Permissable values are 1 - 255 inclusive

choice
	prompt "Select the DMA TX/RX descriptor operating modes"
	depends on STMMAC_ETH
	---help---
	  This driver supports DMA descriptor to operate both in dual buffer
	  (RING) and linked-list(CHAINED) mode. In RING mode each descriptor
	  points to two data buffer pointers whereas in CHAINED mode they
	  points to only one data buffer pointer.

config STMMAC_RING
	bool "Enable Descriptor Ring Mode"

config STMMAC_CHAINED
	bool "Enable Descriptor Chained Mode"

endchoice


endif
```
